/* Copyright (c) 2014-2015, The Linux Foundation. All rights reserved.
 *
 * This program is free software; you can redistribute it and/or modify
 * it under the terms of the GNU General Public License version 2 and
 * only version 2 as published by the Free Software Foundation.
 *
 * This program is distributed in the hope that it will be useful,
 * but WITHOUT ANY WARRANTY; without even the implied warranty of
 * MERCHANTABILITY or FITNESS FOR A PARTICULAR PURPOSE.  See the
 * GNU General Public License for more details.
 */

/*---------------------------------------------------------------------------
 * This file is autogenerated file using gcdb parser. Please do not edit it.
 * Update input XML file to add a new entry or update variable in this file
 * VERSION = "1.0"
 *---------------------------------------------------------------------------*/
&mdss_mdp {
	dsi_ili9806e_wvga_vid: qcom,mdss_dsi_ili9806e_wvga_video {
		qcom,mdss-dsi-panel-name = "ILI9806E wvga video mode dsi panel";
		qcom,cont-splash-enabled;
		qcom,mdss-dsi-panel-controller = <&mdss_dsi0>;
		qcom,mdss-dsi-panel-type = "dsi_video_mode";
		qcom,mdss-dsi-panel-destination = "display_1";
		qcom,mdss-dsi-panel-framerate = <0x3c>;
		qcom,mdss-dsi-virtual-channel-id = <0x0>;
		qcom,mdss-dsi-stream = <0x0>;
		qcom,mdss-dsi-panel-width = <0x1e0>;
		qcom,mdss-dsi-panel-height = <0x356>;
		qcom,mdss-pan-physical-width-dimension = <0x38>;
		qcom,mdss-pan-physical-height-dimension = <0x63>;
		qcom,mdss-dsi-h-front-porch = <0x50>;
		qcom,mdss-dsi-h-back-porch = <0x50>;
		qcom,mdss-dsi-h-pulse-width = <0xa>;
		qcom,mdss-dsi-h-sync-skew = <0x0>;
		qcom,mdss-dsi-v-back-porch = <0xc>;
		qcom,mdss-dsi-v-front-porch = <0xc>;
		qcom,mdss-dsi-v-pulse-width = <0x4>;
		qcom,mdss-dsi-h-left-border = <0x0>;
		qcom,mdss-dsi-h-right-border = <0x0>;
		qcom,mdss-dsi-v-top-border = <0x0>;
		qcom,mdss-dsi-v-bottom-border = <0x0>;
		qcom,mdss-dsi-bpp = <0x18>;
		qcom,mdss-dsi-underflow-color = <0xff>;
		qcom,mdss-dsi-border-color = <0x0>;
		qcom,mdss-dsi-on-command = [39 01 00 00 00 00 06 ff ff 98 06 04 01 15 01 00 00 00 00 02 08 10 15 01 00 00 00 00 02 21 01 15 01 00 00 00 00 02 30 01 15 01 00 00 00 00 02 31 00 15 01 00 00 00 00 02 50 81 15 01 00 00 00 00 02 51 81 15 01 00 00 00 00 02 60 15 15 01 00 00 00 00 02 61 00 15 01 00 00 00 00 02 62 07 15 01 00 00 00 00 02 63 00 15 01 00 00 00 00 02 40 18 15 01 00 00 00 00 02 41 74 15 01 00 00 00 00 02 42 02 15 01 00 00 00 00 02 43 0d 15 01 00 00 00 00 02 44 06 15 01 00 00 00 00 02 52 00 15 01 00 00 00 00 02 53 60 15 01 00 00 00 00 02 57 50 39 01 00 00 00 00 06 ff ff 98 06 04 01 15 01 00 00 00 00 02 a0 00 15 01 00 00 00 00 02 a1 09 15 01 00 00 00 00 02 a2 29 15 01 00 00 00 00 02 a3 0d 15 01 00 00 00 00 02 a4 07 15 01 00 00 00 00 02 a5 18 15 01 00 00 00 00 02 a6 0c 15 01 00 00 00 00 02 a7 0b 15 01 00 00 00 00 02 a8 01 15 01 00 00 00 00 02 a9 05 15 01 00 00 00 00 02 aa 05 15 01 00 00 00 00 02 ab 00 15 01 00 00 00 00 02 ac 0b 15 01 00 00 00 00 02 ad 32 15 01 00 00 00 00 02 ae 2f 15 01 00 00 00 00 02 af 00 15 01 00 00 00 00 02 c0 00 15 01 00 00 00 00 02 c1 00 15 01 00 00 00 00 02 c2 20 15 01 00 00 00 00 02 c3 11 15 01 00 00 00 00 02 c4 09 15 01 00 00 00 00 02 c5 14 15 01 00 00 00 00 02 c6 07 15 01 00 00 00 00 02 c7 05 15 01 00 00 00 00 02 c8 06 15 01 00 00 00 00 02 c9 0a 15 01 00 00 00 00 02 ca 08 15 01 00 00 00 00 02 cb 02 15 01 00 00 00 00 02 cc 09 15 01 00 00 00 00 02 cd 1c 15 01 00 00 00 00 02 ce 16 15 01 00 00 00 00 02 cf 00 39 01 00 00 00 00 06 ff ff 98 06 04 05 15 01 00 00 00 00 02 00 02 39 01 00 00 00 00 06 ff ff 98 06 04 06 15 01 00 00 00 00 02 00 21 15 01 00 00 00 00 02 01 06 15 01 00 00 00 00 02 02 a0 15 01 00 00 00 00 02 03 02 15 01 00 00 00 00 02 04 01 15 01 00 00 00 00 02 05 01 15 01 00 00 00 00 02 06 80 15 01 00 00 00 00 02 07 03 15 01 00 00 00 00 02 08 06 15 01 00 00 00 00 02 09 80 15 01 00 00 00 00 02 0a 00 15 01 00 00 00 00 02 0b 00 15 01 00 00 00 00 02 0c 20 15 01 00 00 00 00 02 0d 20 15 01 00 00 00 00 02 0e 09 15 01 00 00 00 00 02 0f 00 15 01 00 00 00 00 02 10 ff 15 01 00 00 00 00 02 11 e0 15 01 00 00 00 00 02 12 00 15 01 00 00 00 00 02 13 00 15 01 00 00 00 00 02 14 00 15 01 00 00 00 00 02 15 c0 15 01 00 00 00 00 02 16 08 15 01 00 00 00 00 02 17 00 15 01 00 00 00 00 02 18 00 15 01 00 00 00 00 02 19 00 15 01 00 00 00 00 02 1a 00 15 01 00 00 00 00 02 1b 00 15 01 00 00 00 00 02 1c 00 15 01 00 00 00 00 02 1d 00 15 01 00 00 00 00 02 20 01 15 01 00 00 00 00 02 21 23 15 01 00 00 00 00 02 22 45 15 01 00 00 00 00 02 23 67 15 01 00 00 00 00 02 24 01 15 01 00 00 00 00 02 25 23 15 01 00 00 00 00 02 26 45 15 01 00 00 00 00 02 27 67 15 01 00 00 00 00 02 30 12 15 01 00 00 00 00 02 31 22 15 01 00 00 00 00 02 32 22 15 01 00 00 00 00 02 33 22 15 01 00 00 00 00 02 34 87 15 01 00 00 00 00 02 35 96 15 01 00 00 00 00 02 36 aa 15 01 00 00 00 00 02 37 db 15 01 00 00 00 00 02 38 cc 15 01 00 00 00 00 02 39 bd 15 01 00 00 00 00 02 3a 78 15 01 00 00 00 00 02 3b 69 15 01 00 00 00 00 02 3c 22 15 01 00 00 00 00 02 3d 22 15 01 00 00 00 00 02 3e 22 15 01 00 00 00 00 02 3f 22 15 01 00 00 00 00 02 40 22 15 01 00 00 00 00 02 52 10 15 01 00 00 00 00 02 53 10 15 01 00 00 00 00 02 54 13 39 01 00 00 00 00 06 ff ff 98 06 04 07 15 01 00 00 00 00 02 02 77 15 01 00 00 00 00 02 e1 79 15 01 00 00 00 00 02 26 b2 15 01 00 00 00 00 02 b3 10 15 01 00 00 00 00 02 06 13 39 01 00 00 00 00 06 ff ff 98 06 04 05 15 01 00 00 00 00 02 0e 03 39 01 00 00 00 00 06 ff ff 98 06 04 00 05 01 00 00 78 00 02 11 00 05 01 00 00 0a 00 02 29 00 15 01 00 00 00 00 02 53 24];
		qcom,mdss-dsi-off-command = [05 01 00 00 0a 00 02 28 00 05 01 00 00 78 00 02 10 00];
		qcom,mdss-dsi-esd-command = <0x39010000 0x5000302 0x3901 0x500 0x3320000 0x39010000 0x5000338 0x3901 0x500 0x3200000 0x39010000 0x5000311 0x3901 0x500 0x3290000>;
		qcom,mdss-dsi-on-command-state = "dsi_lp_mode";
		qcom,mdss-dsi-off-command-state = "dsi_hs_mode";
		qcom,mdss-dsi-esd-state = "dsi_lp_mode";
		qcom,mdss-dsi-h-sync-pulse = <0x1>;
		qcom,mdss-dsi-traffic-mode = "burst_mode";
		qcom,mdss-dsi-lane-map = "lane_map_0123";
		qcom,mdss-dsi-bllp-eof-power-mode = <0x1>;
		qcom,mdss-dsi-bllp-power-mode = <0x1>;
		qcom,mdss-dsi-lane-0-state;
		qcom,mdss-dsi-lane-1-state;
		qcom,mdss-dsi-panel-timings = <0x751a1100 0x3d45151d 0x1c030400>;
		qcom,mdss-dsi-t-clk-post = <0x4>;
		qcom,mdss-dsi-t-clk-pre = <0x19>;
		qcom,mdss-dsi-bl-min-level = <0x1>;
		qcom,mdss-dsi-bl-max-level = <0xff>;
		qcom,mdss-dsi-dma-trigger = "trigger_sw";
		qcom,mdss-dsi-mdp-trigger = "none";
		qcom,mdss-dsi-bl-pmic-control-type = "bl_ctrl_dcs";
		qcom,mdss-dsi-reset-sequence = <0x1 0x14 0x0 0x2 0x1 0x14>;
	};
};
